;
; PostLab3.asm
;
; Created: 20/02/2024 8:01:55 p. m.
; Author : SANTIAGO

.INCLUDE "M328PDEF.INC"
.CSEG
.ORG 0X00
	JMP SETUP		;RESET VECTOR

.ORG 0X0020
	JMP ISR_TIMER0	;ISR: TIMER0 VECTOR

	LDI R16, LOW(RAMEND)
	OUT SPL, R16
	LDI R17, HIGH(RAMEND)
	OUT SPH, R17

	SEGS: .DB 0x3F,0x06,0x5B,0x4F,0x66,0x6D,0x7D//,0x07,0x7F,0x6F,0x77,0x7C,0x39,0x5E,0x79,0x71
	SEGM: .DB 0x3F,0x06,0x5B,0x4F,0x66,0x6D,0x7D 

SETUP:
	LDI R16, 0b1111_1100				; SALIDAS DEL PD
	OUT DDRD, R16

	LDI R16, 0b0000_0111				;SALIDAS DE PB
	OUT DDRB, R16

	LDI R21, 0
	LDI ZH, HIGH(SEG << 1)
	LDI ZL, LOW(SEG << 1)
	ADD ZL, R21
	LPM R21, Z

	CALL INIT_T0

	LDI R20, 0							;CONTADOR PARA EL TIMER
	LDI R21, 0							;CONTADOR PARA EL DISPLAY 1
	LDI R22, 0							;CONTADOR PARA EL DISPLAY 2

	SEI					;ENABLE GLOBAL INTERRUPTIONS



	LOOP:
	CPI R20, 99			; 1000 MS
	BRNE LOOP
	CLR R20				;IT CLEARS R20

	CALL DISPLAY

	INC R21
	SBRC R21, 4
	LDI R23, 0

	JMP LOOP



	DISPLAY:
	CLR R22
	CBI PORTB, PB0
	MOV R22, R21
	LDI ZH, HIGH(SEG << 1)
	LDI ZL, LOW(SEG << 1)
	ADD ZL, R22
	LPM R22, Z

	SBRC R22, 6
	SBI PORTB, PB0
	SBRS R22, 6
	CBI PORTB, PB0

	LSL R22
	LSL R22
	
	OUT PORTD, R22
	RET








INIT_T0:
	LDI R16, (1 << CS02) | (1 << CS00)
	OUT TCCR0B, R16								;SETEA EL PRESCALER

	LDI R16, 99									;OVERflOW
	OUT TCNT0, R16								;CARGA EL VALOR INICIAL DEL TIMER

	LDI R16, (1 << TOIE0)
	STS TIMSK0, R16				
	RET




